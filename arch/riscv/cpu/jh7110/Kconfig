## arch/riscv/cpu/jh7110/Kconfig
```kconfig
# SPDX-License-Identifier: GPL-2.0+
#
# Copyright (C) 2022 StarFive Technology Co., Ltd.

config STARFIVE_JH7110
	bool
	select ARCH_EARLY_INIT_R
	select CLK_JH7110
	select CPU
	select CPU_RISCV
	select RAM
	select RESET_JH7110
	select SUPPORT_SPL
	select SPL_RAM if SPL
	select SPL_STARFIVE_DDR
	select SYS_CACHE_SHIFT_6
	select SPL_ZERO_MEM_BEFORE_USE
	select PINCTRL_STARFIVE_JH7110
	imply MMC
	imply MMC_BROKEN_CD
	imply MMC_SPI
	imply RISCV_TIMER if (RISCV_SMODE || SPL_RISCV_SMODE)
	imply SIFIVE_CACHE
	imply SIFIVE_CCACHE
	imply SMP
	imply SPI
	imply SPL_CPU
	imply SPL_LOAD_FIT
	imply SPL_OPENSBI
	imply SPL_RISCV_ACLINT
	imply SPL_SYS_MALLOC_CLEAR_ON_INIT

config STARFIVE_JH7110_L2CC_FLUSH
 bool "Support Level 2 Cache Controller Flush operation of Starfive JH7110"

if STARFIVE_JH7110_L2CC_FLUSH

config STARFIVE_JH7110_L2CC_FLUSH_START
 hex "Level 2 Cache Flush operation start"
 default 0x40000000

config STARFIVE_JH7110_L2CC_FLUSH_SIZE
 hex "Level 2 Cache Flush operation size"
 default 0x400000000

endif # STARFIVE_JH7110_L2CC_FLUSH
```
